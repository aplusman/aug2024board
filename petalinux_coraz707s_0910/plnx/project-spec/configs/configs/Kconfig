## petalinux_coraz707s_0910/plnx/project-spec/configs/configs/Kconfig
```kconfig
mainmenu "PetaLinux System Configuration"
config SUBSYSTEM_TYPE_LINUX
        bool
        default y
        select SYSTEM_ZYNQ

config SYSTEM_ZYNQ
        bool "ZYNQ Configuration"
        help
          ZYNQ Configuration for petalinux project.
          All these config options will be in /home/david/r09522848/petalinux2024/coraz707s_0909/plnx_coraz070s_0910/project-spec/configs/config

config SUBSYSTEM_DISTRO_PETALINUX
        bool
        default y
        help

source /home/david/r09522848/petalinux2024/coraz707s_0909/plnx_coraz070s_0910/project-spec/configs/configs/Kconfig.main
```

## petalinux_coraz707s_0910/plnx/project-spec/configs/rootfsconfigs/Kconfig.user
```kconfig
menu "user packages " 
config app-test-01  
	 bool "app-test-01"
	 help
	
config gpio-demo  
	 bool "gpio-demo"
	 help
	
config peekpoke  
	 bool "peekpoke"
	 help
	
endmenu
```
